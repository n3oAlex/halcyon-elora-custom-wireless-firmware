/*
 * Dongle-only devicetree tweaks.
 *
 * ZMK applies exactly one overlay from config/ per build, chosen by shield name.
 * Keep this file dongle-specific and never add a shared halcyon_elora.overlay,
 * it would shadow this one.
 *
 * The Cirque touchpad is read on the right half and streamed to the dongle, so
 * the input listener (and therefore all pointer tuning) lives here.
 */

#include <input/processors.dtsi>

#define NAV    1
#define SCROLL 6

&trackpad_listener {
    /* Cursor speed: pointer deltas times MUL/DIV. 3 1 = three times raw. */
    input-processors = <&zip_xy_scaler 3 1>;

    /* Precision mode while NAV (Space) is held: raw 1:1 deltas. Only the first matching
     * child applies, so the base scaler above is skipped here. */
    precision {
        layers = <NAV>;
        input-processors = <&zip_xy_scaler 1 1>;
    };

    /* Scroll mode while SCROLL (Backspace) is held: finger movement becomes wheel events
     * at a third of raw speed. Too fast or too slow: change 1 3.
     * Wrong direction: prepend <&zip_xy_transform (INPUT_TRANSFORM_Y_INVERT)> and
     * #include <dt-bindings/zmk/input_transform.h> at the top. */
    scroller {
        layers = <SCROLL>;
        input-processors = <&zip_xy_scaler 1 3>, <&zip_xy_to_scroll_mapper>;
    };
};
