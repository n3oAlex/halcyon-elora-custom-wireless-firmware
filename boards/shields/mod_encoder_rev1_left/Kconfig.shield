## drivers/Kconfig
```kconfig
if SENSOR

rsource "sensor/ec11_classic/Kconfig"

endif # SENSOR

rsource "behavior/display_toggle/Kconfig"
```

## drivers/behavior/display_toggle/Kconfig
```kconfig
config ZMK_BEHAVIOR_DISPLAY_TOGGLE
    bool "Display toggle behavior (forces the local display and backlight off)"
    default y
    depends on DT_HAS_ZMK_BEHAVIOR_DISPLAY_TOGGLE_ENABLED
```

## drivers/sensor/ec11_classic/Kconfig
```kconfig
# Copyright (c) 2020 The ZMK Contributors
# SPDX-License-Identifier: MIT

menuconfig EC11_CLASSIC
    bool "Upstream-ZMK two-line EC11 driver (Halcyon encoder rev 1.0)"
    default y
    depends on DT_HAS_HALCYON_EC11_CLASSIC_ENABLED
    depends on GPIO
    help
      Vendored copy of upstream ZMK's EC11 driver, kept separate from the splitkb fork's rewrite.

if EC11_CLASSIC

choice EC11_CLASSIC_TRIGGER_MODE
    prompt "Trigger mode"
    default EC11_CLASSIC_TRIGGER_GLOBAL_THREAD
    help
      Specify the type of triggering to be used by the driver.

config EC11_CLASSIC_TRIGGER_NONE
    bool "No trigger"

config EC11_CLASSIC_TRIGGER_GLOBAL_THREAD
    bool "Use global thread"
    depends on GPIO
    select EC11_CLASSIC_TRIGGER

config EC11_CLASSIC_TRIGGER_OWN_THREAD
    bool "Use own thread"
    depends on GPIO
    select EC11_CLASSIC_TRIGGER

endchoice

config EC11_CLASSIC_TRIGGER
    bool

config EC11_CLASSIC_THREAD_PRIORITY
    int "Thread priority"
    depends on EC11_CLASSIC_TRIGGER_OWN_THREAD
    default 10
    help
      Priority of thread used by the driver to handle interrupts.

config EC11_CLASSIC_THREAD_STACK_SIZE
    int "Thread stack size"
    depends on EC11_CLASSIC_TRIGGER_OWN_THREAD
    default 1024
    help
      Stack size of thread used by the driver to handle interrupts.

endif # EC11_CLASSIC
```

## dts/bindings/behaviors/zmk,behavior-display-toggle.yaml
```yaml
# Copyright (c) 2026 n3oAlex
# SPDX-License-Identifier: MIT

description: |
  Switches the display (and backlight) of the part that runs it off until pressed again.
  Global locality: reaches every half, no-op where there is no display.

compatible: "zmk,behavior-display-toggle"

include: zero_param.yaml
```

## dts/bindings/sensor/halcyon,ec11-classic.yaml
```yaml
description: |
  Upstream-ZMK two-line EC11 driver, vendored for the Halcyon encoder module rev 1.0 (ALPS EC12)

compatible: "halcyon,ec11-classic"

properties:
  label:
    type: string
    required: false
    deprecated: true
  a-gpios:
    type: phandle-array
    required: true
    description: A pin for the encoder
  b-gpios:
    type: phandle-array
    required: true
    description: A pin for the encoder
  resolution:
    type: int
    description: Number of pulses per tick
    deprecated: true
    required: false
  steps:
    type: int
    description: Number of pulses in one full rotation
    required: false
```
